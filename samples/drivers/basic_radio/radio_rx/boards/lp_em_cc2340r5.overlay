/*
 * Copyright (c) 2026 Texas Instruments Incorporated
 * SPDX-License-Identifier: Apache-2.0
 *
 * basic_radio sample overlay for CC23x0-based LaunchPads.
 *
 * The PHY comes from cc2340r5-radio-phys.dtsi, the list of PHYs certified
 * on CC2340R5. Each entry names a SmartRF Studio LRF_Config provided by
 * hal_ti and one operating mode node per mode, which states the mode's
 * modulation, datarate, deviation and frame format.
 *
 * phy0 selects the 1 Mbps mode of the BLE 1 Mbps / 2 Mbps / Coded PHY and
 * sets optional boot-time defaults (overridden by basic_radio_config()).
 *
 * To use another certified PHY, point phy-mode at one of the other
 * PHY labels.
 *
 * CUSTOM PHY EXAMPLE (see ti,cc23x0-radio-phy-config.yaml):
 *  1. Export PHY from SmartRF Studio as C (keep default LRF_config name)
 *  2. Add to application CMakeLists.txt:
 *       target_sources(app PRIVATE rcl_settings_custom.c)
 *  3. Define custom PHY in overlay (or in a separate .dtsi):
 *     / {
 *         radio-phys {
 *             my_custom_phy: custom-phy {
 *                 compatible = "ti,cc23x0-radio-phy-config";
 *                 ti,lrf-config = "LRF_config";
 *                 ti,len-pos = <8>;
 *                 ti,num-len-bits = <8>;
 *                 ti,phy-feature = <0x0000>;
 *                 datarate-bps = <1000000>;
 *                 modulation = "2-gfsk";
 *                 deviation-hz = <250000>;
 *                 frequency-min-hz = <2400000000>;
 *                 frequency-max-hz = <2483500000>;
 *                 crc-enable;
 *                 variable-length;
 *                 boot-frequency-hz = <2440000000>;
 *                 boot-sync-word = <0x930B51DE>;
 *                 boot-tx-power-dbm = <0>;
 *                 boot-max-packet-length = <255>;
 *             };
 *         };
 *     };
 *  4. Point phy-mode at the custom PHY:
 *       phy-mode = <&my_custom_phy>;
 */

#include <ti/cc2340r5-radio-phys.dtsi>

/ {
	basic_radio0: basic_radio {
		compatible = "ti,cc23x0-basic-radio";
		status = "okay";

		phy0: phy_default {
			phy-mode = <&ti_phy_2_4_ghz_bluetooth_5_le_1_mbps>;
		};
	};
};