## drivers/basic_radio/backends/ti/cc14x0/Kconfig
```kconfig
# Copyright (c) 2026 Texas Instruments Incorporated
# SPDX-License-Identifier: Apache-2.0

config PROP_RF_CC14XX_TRX
	bool "TI CC14xx TRX external transceiver prop_rf backend"
	default y
	depends on DT_HAS_TI_CC14XX_PROP_RF_ENABLED
	depends on DT_HAS_TI_CC140XP_TRX_ENABLED
	depends on SPI
	depends on GPIO
	select SPI_ASYNC
	select CRC
	select RING_BUFFER
	help
	  Backend for the TI CC14xx external transceiver connected via SPI.
	  The TRX Host library and ti_cc14xx HAL are bundled directly under
	  this backend; no separate TI_CC14XX module is required.

if PROP_RF_CC14XX_TRX

config TI_CC14XX_INIT_PRIORITY
	int "TI CC14xx HAL driver init priority"
	default 80
	help
	  Initialization priority for the ti_cc14xx SPI transceiver HAL driver.
	  Must be lower than CONFIG_PROP_RF_INIT_PRIORITY.

module = TI_CC140XP
module-str = ti_cc140xp
source "subsys/logging/Kconfig.template.log_config"

endif # PROP_RF_CC14XX_TRX
```

## dts/bindings/basic_radio/basic-radio-base.yaml
```yaml
# Copyright (c) 2026 Texas Instruments Incorporated
# SPDX-License-Identifier: Apache-2.0

description: |
  Common properties of a Basic Radio device. Include-only: each radio
  binding (for example ti,cc23x0-basic-radio.yaml) includes this file and
  adds its device-specific properties.

  A Basic Radio device can operate with multiple PHY configurations. Each
  PHY child selects a waveform mode (via phy-mode). Runtime parameters are
  set via basic_radio_config().

include: [base.yaml]

properties:
  "#address-cells":
    const: 1
  "#size-cells":
    const: 0

child-binding:
  description: |
    One PHY configuration (waveform mode). Selects a PHY from a
    vendor-specific radio-phy-config node via phy-mode.
  properties:
    phy-mode:
      type: phandle
      required: true
      description: |
        Reference to a PHY node in a radio-phy-config node.
        The PHY node defines the waveform (datarate, modulation, etc.)
        and the characterized frequency range.
```

## dts/bindings/basic_radio/ti,cc14x0-basic-radio.yaml
```yaml
# Copyright (c) 2026 Texas Instruments Incorporated
# SPDX-License-Identifier: Apache-2.0

description: |
  TI CC14x0 sub-1 GHz transceiver connected over SPI, driven through the
  Basic Radio API.

  The node describes the SPI link and the control GPIOs. It is provided by
  a shield, for example ti_bp_cc140xp. Each child selects a PHY from
  ti,cc14x0-radio-phy-config nodes, for example from
  <ti/cc1407p-radio-phys.dtsi>.

  The application selects the PHY:

    &basic_radio0 {
        phy0: phy_default {
            phy-mode = <&ti_phy_sub_1_ghz_prop_50_kbps_2_gfsk_lp>;
        };
    };

compatible: "ti,cc14x0-basic-radio"

include: [spi-device.yaml, basic-radio-base.yaml]

properties:
  reset-gpios:
    type: phandle-array
    required: true
    description: |
      RESET_N line of the transceiver.

  trx-host-spi-int-gpios:
    type: phandle-array
    required: true
    description: |
      SPI_INT line. The transceiver asserts it to request a transaction
      from the host.

  poci-gpios:
    type: phandle-array
    required: true
    description: |
      POCI (MISO) line sampled as a GPIO. The transceiver uses it to signal
      ready during the SPI handshake.

  ti,dio2-function:
    type: int
    default: 0x54
    description: |
      TRX_Dio2Config value for DIO2 (PA control). Default 0x54.

  ti,dio3-function:
    type: int
    default: 0x12
    description: |
      TRX_Dio3Config value for DIO3 (LNA control). Default 0x12.
```

## dts/bindings/basic_radio/ti,cc14x0-radio-phy-config.yaml
```yaml
# Copyright (c) 2026 Texas Instruments Incorporated
# SPDX-License-Identifier: Apache-2.0

description: |
  TI CC14x0 PHY: names the main register configuration that holds the
  radio settings and describes one operating mode. The register data
  itself is C, exported from SmartRF Studio 8; this node only carries
  metadata the driver needs.

  Several nodes may name the same configuration and differ only in
  ti,phy-feature (sub-PHYs of one export, for example Wi-SUN FSK operating
  modes and OFDM options). The driver stores each distinct configuration
  once on the transceiver.

  Certified PHYs are listed per transceiver, for example in
  <ti/cc1407p-radio-phys.dtsi>.

  Custom PHY:
    1. Export the PHY from SmartRF Studio 8 as C, rename LRF_mainRegConfig
       and LRF_mainRegConfig_byteCount to unique names, and add the .c file
       to the application (target_sources(app PRIVATE ...)).
    2. Add a node with this compatible to the application overlay, set
       ti,main-config to the renamed configuration.
    3. Point phy-mode of a ti,cc14x0-basic-radio PHY child at this PHY node.

  Example:

    radio-phys {
        my_phy: my-phy {
            compatible = "ti,cc14x0-radio-phy-config";
            ti,main-config = "LRF_mainRegConfig_my_phy";
            ti,rf-mode = "prop-fsk";
            ti,modem = "fsk";
            ti,payload-header = "gen-fsk";
            ti,phy-feature = <0x0000>;
            datarate-bps = <50000>;
            modulation = "2-gfsk";
            deviation-hz = <25000>;
            frequency-min-hz = <779000000>;
            frequency-max-hz = <930000000>;
            crc-enable;
            variable-length;
        };
    };

  The mode properties must match the C export. The build does not check
  them against the register data.

compatible: "ti,cc14x0-radio-phy-config"

properties:
  ti,main-config:
    type: string
    required: true
    description: |
      C identifier of the const uint32_t[] main register configuration
      (LRF_mainRegConfig of the export, renamed). The driver also links
      <name>_byteCount.

  ti,rf-mode:
    type: string
    required: true
    enum:
      - "sun"
      - "prop-fsk"
      - "prop-fsk-peak-agc"
      - "ook"
      - "xlr"
    description: |
      RF firmware the transceiver runs for this PHY (TRX_RF_MODE of the
      export). Switching to a PHY with another mode reloads the firmware.

  ti,modem:
    type: string
    required: true
    enum:
      - "fsk"
      - "ofdm"
      - "oqpsk"
    description: |
      Modem used by the radio commands (TRX_RadioCommand_Modem).

  ti,payload-header:
    type: string
    required: true
    enum:
      - "gen-fsk"
      - "sun-fsk"
      - "sun-ofdm"
      - "sun-oqpsk"
    description: |
      Format of the payload header exchanged with the transceiver on TX and
      RX streams (TRX_PayloadHeader_GenFSK, _SunFSK, _SunOFDM, _SUNOQPSK).

  ti,phy-feature:
    type: int
    required: true
    description: |
      option_mask written to the radio commands (TRX_PHY_FEATURE_* of the
      export). Selects the sub-PHY within the configuration. 0 for PHYs
      without sub-PHYs.

  ti,tx-rate:
    type: int
    default: 0
    description: |
      TX rate field of the payload header: MCS for sun-ofdm, rate mode for
      sun-oqpsk. Ignored for other headers.

  datarate-bps:
    type: int
    required: true
    description: |
      Data rate in bits per second (e.g., 50000 for 50 kbps).

  modulation:
    type: string
    required: true
    enum:
      - "2-gfsk"
      - "4-gfsk"
      - "2-fsk"
      - "ook"
      - "msk"
      - "oqpsk"
      - "ofdm"
    description: |
      Modulation scheme.

  deviation-hz:
    type: int
    required: true
    description: |
      Frequency deviation in Hz for FSK/GFSK (0 for OQPSK/OFDM).

  frequency-min-hz:
    type: int
    required: true
    description: |
      Lowest characterized carrier frequency in Hz.

  frequency-max-hz:
    type: int
    required: true
    description: |
      Highest characterized carrier frequency in Hz.

  crc-enable:
    type: boolean
    required: true
    description: |
      Hardware CRC enabled for this mode.

  variable-length:
    type: boolean
    required: true
    description: |
      Frames carry a length byte (true) or fixed length (false).

  preamble-length:
    type: int
    description: |
      Preamble length in bytes (0 = default for the PHY).

  sync-word-length:
    type: int
    description: |
      Sync word length in bytes (0 = default for the PHY).

  whitening-enable:
    type: boolean
    description: |
      Data whitening enabled (default: false).

  boot-frequency-hz:
    type: int
    description: |
      Boot-time default center frequency in Hz. Must be within the PHY's
      characterized range (frequency-min-hz .. frequency-max-hz).
      Overridden by basic_radio_config().

  boot-sync-word:
    type: int
    description: |
      Sync word programmed in the configuration, LSB-aligned. The
      transceiver cannot change it at runtime; basic_radio_config() with
      another sync word returns -ENOTSUP.

  boot-tx-power-dbm:
    type: int
    description: |
      Boot-time default TX power in dBm. Must be within the board's power
      table range. Overridden by basic_radio_config().

  boot-max-packet-length:
    type: int
    description: |
      Boot-time default maximum payload length in bytes.
      Overridden by basic_radio_config().
```

## dts/bindings/basic_radio/ti,cc23x0-basic-radio.yaml
```yaml
# Copyright (c) 2026 Texas Instruments Incorporated
# SPDX-License-Identifier: Apache-2.0

description: |
  TI CC23x0 on-chip radio, driven through the Basic Radio API.

  Each child selects a PHY from ti,cc23x0-radio-phy-config nodes, for
  example from <ti/cc2340r5-radio-phys.dtsi>.

  Example:

    basic_radio0: basic_radio {
        compatible = "ti,cc23x0-basic-radio";
        #address-cells = <1>;
        #size-cells = <0>;

        phy0: phy_default {
            phy-mode = <&ti_phy_2_4_ghz_bluetooth_5_le_1_mbps>;
        };
    };

compatible: "ti,cc23x0-basic-radio"

include: [basic-radio-base.yaml]
```

## dts/bindings/basic_radio/ti,cc23x0-radio-phy-config.yaml
```yaml
# Copyright (c) 2026 Texas Instruments Incorporated
# SPDX-License-Identifier: Apache-2.0

description: |
  TI CC23x0 PHY: names the LRF_Config that holds the radio settings and
  describes one operating mode. The register data itself is C, exported
  from SmartRF Studio; this node only carries metadata the driver needs.

  Certified PHYs are listed per SoC, for example in
  <ti/cc2340r5-radio-phys.dtsi>. Their LRF_Config
  objects live in hal_ti (source/ti/radio_phys/) and are named
  LRF_config_<phy>.

  Custom PHY:
    1. Export the PHY from SmartRF Studio as C and add the .c file to the
       application (target_sources(app PRIVATE ...)).
    2. Add a node with this compatible to the application overlay, set
       ti,lrf-config to the name of the exported LRF_Config (LRF_config by
       default).
    3. Point phy-mode of a basic-radio-base PHY child at this PHY node.

  Example:

    radio-phys {
        my_phy: my-phy {
            compatible = "ti,cc23x0-radio-phy-config";
            ti,lrf-config = "LRF_config";
            ti,len-pos = <8>;
            ti,num-len-bits = <8>;
            ti,phy-feature = <0x0000>;
            datarate-bps = <1000000>;
            modulation = "2-gfsk";
            deviation-hz = <250000>;
            frequency-min-hz = <2400000000>;
            frequency-max-hz = <2483500000>;
            crc-enable;
            variable-length;
        };
    };

  The mode properties must match the C export. The build does not check
  them against the register data.

compatible: "ti,cc23x0-radio-phy-config"

properties:
  ti,lrf-config:
    type: string
    required: true
    description: |
      C identifier of the const LRF_Config for this PHY. The driver declares
      it extern and links against it.

  ti,len-pos:
    type: int
    required: true
    description: |
      PBE_GENERIC_RAM.LENCFG.LENPOS of the export: bit position of the
      length field in the frame header. Required by the generic PBE driver.

  ti,num-len-bits:
    type: int
    required: true
    description: |
      PBE_GENERIC_RAM.LENCFG.NUMLENBITS of the export: size of the length
      field in bits. Required by the generic PBE driver.

  ti,phy-feature:
    type: int
    required: true
    description: |
      phyFeatures word written to the radio commands. Selects which
      feature-gated register segments are applied. 0 for PHYs without
      sub-PHYs.

  datarate-bps:
    type: int
    required: true
    description: |
      Data rate in bits per second (e.g., 1000000 for 1 Mbps).

  modulation:
    type: string
    required: true
    enum:
      - "2-gfsk"
      - "4-gfsk"
      - "2-fsk"
      - "ook"
      - "msk"
      - "oqpsk"
      - "ofdm"
    description: |
      Modulation scheme.

  deviation-hz:
    type: int
    required: true
    description: |
      Frequency deviation in Hz for FSK/GFSK (0 for OQPSK/OFDM).

  frequency-min-hz:
    type: int
    required: true
    description: |
      Lowest characterized carrier frequency in Hz.

  frequency-max-hz:
    type: int
    required: true
    description: |
      Highest characterized carrier frequency in Hz.

  crc-enable:
    type: boolean
    required: true
    description: |
      Hardware CRC enabled for this mode.

  variable-length:
    type: boolean
    required: true
    description: |
      Frames carry a length byte (true) or fixed length (false).

  preamble-length:
    type: int
    description: |
      Preamble length in bytes (0 = default for the PHY).

  sync-word-length:
    type: int
    description: |
      Sync word length in bytes (0 = default for the PHY).

  whitening-enable:
    type: boolean
    description: |
      Data whitening enabled (default: false).

  boot-frequency-hz:
    type: int
    description: |
      Boot-time default center frequency in Hz. Must be within the PHY's
      characterized range (frequency-min-hz .. frequency-max-hz).
      Overridden by basic_radio_config().

  boot-sync-word:
    type: int
    description: |
      Boot-time default sync word, LSB-aligned.
      Overridden by basic_radio_config().

  boot-tx-power-dbm:
    type: int
    description: |
      Boot-time default TX power in dBm. Must be within the PHY's power table range.
      Overridden by basic_radio_config().

  boot-max-packet-length:
    type: int
    description: |
      Boot-time default maximum payload length in bytes.
      Overridden by basic_radio_config().
```

## samples/drivers/basic_radio/radio_rx/sample.yaml
```yaml
sample:
  name: Basic Radio RX
  description: Receive packets asynchronously via the vendor-neutral basic_radio API.
  integration_platforms:
    - lp_em_cc2340r5
```

## samples/drivers/basic_radio/radio_test_cw/sample.yaml
```yaml
sample:
  name: Basic Radio Tone
  description: Transmit continuous wave (tone) asynchronously via the vendor-neutral basic_radio API.
  integration_platforms:
    - lp_em_cc2340r5
```

## samples/drivers/basic_radio/radio_tx/sample.yaml
```yaml
sample:
  name: Basic Radio TX
  description: Transmit packets asynchronously via the vendor-neutral basic_radio API.
  integration_platforms:
    - lp_em_cc2340r5
```
